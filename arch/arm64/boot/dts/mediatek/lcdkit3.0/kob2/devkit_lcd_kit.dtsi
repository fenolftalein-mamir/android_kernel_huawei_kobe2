/*---------------------------------------------------------------------------
 * This file is autogenerated file using huawei LCD parser. Please do not edit it.
 * Update input XML file to add a new entry or update variable in this file
 * Parser location: vendor/huawei/chipset_common/devkit/lcdkit/tools 
 *---------------------------------------------------------------------------*/


#include "kob2_auo_otm1901a_5p2_1080p_video_default.dtsi"
#include "kob2_boe_ft8201_8p1.dtsi"
#include "kob2_inx_ft8201_8p1.dtsi"