/* Copyright (c) 2013, The Linux Foundation. All rights reserved.
 *
 * This program is free software; you can redistribute it and/or modify
 * it under the terms of the GNU General Public License version 2 and
 * only version 2 as published by the Free Software Foundation.
 *
 * This program is distributed in the hope that it will be useful,
 * but WITHOUT ANY WARRANTY; without even the implied warranty of
 * MERCHANTABILITY or FITNESS FOR A PARTICULAR PURPOSE.  See the
 * GNU General Public License for more details.
 */

/*-------------------------------------------------------------------------
 * This file is autogenerated file using gcdb parser. Please do not edit it.
 * Update input XML file to add a new entry or update variable in this file
 * VERSION = 1.1
 *-----------------------------------------------------------------------*/
&huawei_lcd_config {
	dsi_kob2_boe_ft8201_8p1: lcd_kit_kob2_boe_ft8201_8p1 {
		compatible = "boe_ft8201_8p1_800p_video";
		lcd-kit,panel-name = "BOE_FT8201 8P1 VIDEO TFT 800 x 1280";
		lcd-kit,panel-type = <0x1>;
		lcd-kit,panel-xres = <800>;
		lcd-kit,panel-yres = <1280>;
		lcd-kit,panel-width = <108>;
		lcd-kit,panel-height = <173>;
		lcd-kit,panel-on-cmds = <0x39 0x01 0x00 0x00 0x78 0x01 0x02 0x11 0x00
				0x39 0x01 0x00 0x00 0x0A 0x00 0x03 0x50 0x5A 0x0A
				0x39 0x01 0x00 0x00 0x0A 0x00 0x11 0x80 0xB7 0x6F 0x03 0x00 0x0E 0x1A 0x29 0x39 0x4A 0x4E 0x7E 0x49 0x7F 0xBD 0x8E 0xA4
				0x39 0x01 0x00 0x00 0x0A 0x00 0x11 0x90 0x74 0x6C 0x59 0x45 0x31 0x1F 0x0B 0x00 0x0E 0x1A 0x29 0x39 0x4A 0x4E 0x7E 0x49
				0x39 0x01 0x00 0x00 0x0A 0x00 0x0D 0xA0 0x7F 0xBD 0x8E 0xA4 0x74 0x6C 0x59 0x45 0x31 0x1F 0x0B 0x00
				0x39 0x01 0x00 0x00 0x0A 0x00 0x03 0x50 0x5A 0x19
				0x39 0x01 0x00 0x00 0x0A 0x00 0x11 0x80 0xE8 0xD5 0xC5 0xB8 0xAD 0xA5 0x9D 0x98 0x92 0x8C 0x88 0x83 0x55 0xC5 0xFC 0xCF
				0x39 0x01 0x00 0x00 0x0A 0x00 0x11 0x90 0xFC 0xCF 0xFC 0xCF 0xCF 0xCF 0x0F 0xFF 0xAF 0xB5 0x71 0x0E 0x6C 0x4A 0x69 0x08
				0x39 0x01 0x00 0x00 0x0A 0x00 0x04 0xA0 0x00 0x02 0x04
				0x39 0x01 0x00 0x00 0x0A 0x00 0x03 0x50 0x5A 0x23
				0x39 0x01 0x00 0x00 0x0A 0x00 0x07 0x90 0xFF 0x0F 0x00 0x00 0x2C 0x01
				0x39 0x01 0x00 0x00 0x0A 0x00 0x03 0x50 0x00 0x2F
				0x39 0x01 0x00 0x00 0x10 0x01 0x02 0x29 0x00>;
		lcd-kit,panel-on-cmds-state = "dsi_lp_mode";
		lcd-kit,panel-off-cmds = <0x39 0x01 0x00 0x00 0x0A 0x01 0x02 0x28 0x00
				0x39 0x01 0x00 0x00 0x78 0x01 0x02 0x10 0x00
				0x39 0x01 0x00 0x00 0x0A 0x00 0x02 0x04 0x5A
				0x39 0x01 0x00 0x00 0x96 0x01 0x02 0x05 0x5A>;
		lcd-kit,panel-off-cmds-state = "dsi_lp_mode";
		lcd-kit,backlight-cmds = <0x39 0x01 0x00 0x00 0x0A 0x00 0x03 0x50 0x5A 0x23
					0x39 0x01 0x00 0x00 0x0A 0x00 0x03 0x90 0x00 0x00>;
		lcd-kit,backlight-cmds-state = "dsi_lp_mode";
		lcd-kit,tp-color-cmds = <>;
		lcd-kit,scan-forword-cmds = <>;
		lcd-kit,scan-revert-cmds = <>;
		lcd-kit,scan-revert-cmds-state = "dsi_lp_mode";
		lcd-kit,scan-forword-cmds-state = "dsi_lp_mode";
		lcd-kit,cabc-off-cmds = <0x39 0x01 0x00 0x00 0x0A 0x00 0x03 0x50 0x5A 0x23
				0x15 0x01 0x00 0x00 0x0A 0x00 0x02 0x95 0x00
				0x39 0x01 0x00 0x00 0x0A 0x00 0x03 0x50 0x00 0x2f>;
		lcd-kit,cabc-off-cmds-state = "dsi_lp_mode";
		lcd-kit,cabc-ui-cmds = <0x39 0x01 0x00 0x00 0x0A 0x00 0x03 0x50 0x5A 0x23
				0x15 0x01 0x00 0x00 0x0A 0x00 0x02 0x95 0x01
				0x39 0x01 0x00 0x00 0x0A 0x00 0x03 0x50 0x00 0x2f>;
		lcd-kit,cabc-ui-cmds-state = "dsi_lp_mode";
		lcd-kit,cabc-still-cmds = <0x39 0x01 0x00 0x00 0x0A 0x00 0x03 0x50 0x5A 0x23
				0x15 0x01 0x00 0x00 0x0A 0x00 0x02 0x95 0x02
				0x39 0x01 0x00 0x00 0x0A 0x00 0x03 0x50 0x00 0x2f>;
		lcd-kit,cabc-still-cmds-state = "dsi_lp_mode";
		lcd-kit,cabc-moving-cmds = <0x39 0x01 0x00 0x00 0x0A 0x00 0x03 0x50 0x5A 0x23
				0x15 0x01 0x00 0x00 0x0A 0x00 0x02 0x95 0x03
				0x39 0x01 0x00 0x00 0x0A 0x00 0x03 0x50 0x00 0x2f>;
		lcd-kit,cabc-moving-cmds-state = "dsi_lp_mode";
		lcd-kit,panel-bl-maxnit-command = <0x06 0x01 0x00 0x00 0x0a 0x00 0x01 0xdb>;
		lcd-kit,panel-bl-maxnit-command-state = "dsi_lp_mode";
		lcd-kit,panel-lcm-type = <2>;
		lcd-kit,panel-ldi-dsi-mode = <1>;
		lcd-kit,panel-dsi-switch-mode = <0>;
		lcd-kit,panel-dsi-switch-mode-en = <0>;
		lcd-kit,panel-ldi-trans-seq = <0>;
		lcd-kit,panel-ldi-data-padding = <0>;
		lcd-kit,panel-ldi-packet-size = <256>;
		lcd-kit,panel-ldi-ps = <2>;
		lcd-kit,panel-vfp-lp = <0>;
		lcd-kit,panel-fbk-div = <1>;
		lcd-kit,panel-orientation = <1>;
		lcd-kit,panel-bpp = <2>;
		lcd-kit,panel-bgr-fmt = <0>;
		lcd-kit,panel-cmd-type = <8>;
		lcd-kit,panel-pxl-clk = <0>;
		lcd-kit,panel-pxl-clk-div = <0>;
		lcd-kit,panel-data-rate = <500>;
		lcd-kit,mipi-lane-nums = <4>;
		lcd-kit,h-back-porch = <46>;
		lcd-kit,h-front-porch = <46>;
		lcd-kit,h-pulse-width = <14>;
		lcd-kit,project-id-support = <1>;
		lcd-kit,v-back-porch = <77>;
		lcd-kit,v-front-porch = <101>;
		lcd-kit,v-pulse-width = <8>;
		lcd-kit,mipi-clk-post-adjust = <0>;
		lcd-kit,mipi-lp11-flag = <0>;
		lcd-kit,esd-support = <0>;
		lcd-kit,tp-color-support = <0>;
		lcd-kit,lcd-vci = <2 171 3000000>;
		lcd-kit,lcd-iovcc = <2 177 1800000>;
		lcd-kit,lcd-reset = <2 45 0>;
		lcd-kit,tp-reset = <2 174 0>;
		lcd-kit,power-on-stage = <2 1 4
				1 1 10
				7 1 2
				5 1 2
				8 0 8
				5 0 8
				7 1 2
				5 1 35
				6 1 0
				8 1 0>;
		lcd-kit,lp-on-stage = <0 0 0>;
		lcd-kit,hs-on-stage = <0 0 0>;
		lcd-kit,hs-off-stage = <0 0 0>;
		lcd-kit,lp-off-stage = <0 0 0>;
		lcd-kit,power-off-stage = <6 0 0
				1 0 15
				7 0 0
				8 0 0
				5 0 0
				2 0 0>;
		lcd-kit,pt-support = <1>;
		lcd-kit,panel-density = <320>;
		lcd-kit,ssc-disable = <1>;
		lcd-kit,inversion-support = <1>;
		lcd-kit,check-reg-support = <0>;
		lcd-kit,panel-bl-min = <20>;
		lcd-kit,panel-bl-max = <1514>;
		lcd-kit,panel-bl-max-nit = <450>;
		lcd-kit,mipi-rg-vrefsel-vcm-adjust = <4>;
		lcd-kit,mipi-non-continue-enable = <0>;
		lcd-kit,panel-getblmaxnit-type = <1>;
		lcd-kit,panel-bl-ic-ctrl-type = <3>;
		lcd-kit,panel-bias-ic-ctrl-type = <3>;
		lcd-kit,panel-on-always-reset = <1>;
		lcd-kit,panel-gpio-offset = <329>;
    };
};